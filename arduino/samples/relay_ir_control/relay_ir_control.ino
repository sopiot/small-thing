#include <thing_client.h>
//#include <IRremote.h>

#define DHT_TYPE DHT11

#define LIGHT_PIN A0
#define DISTANCE_TRIGGER_PIN 4
#define DISTANCE_RECEIVE_PIN 5
#define RELAY_PIN 7

//IRsend irsend;

//IR_signals...
unsigned int ON[] = {9096, 4508, 576, 544, 576, 536, 580, 540, 568, 548, 568, 536, 580,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 1644, 584};
unsigned int OFF[] = {9096, 4516, 572, 540, 580, 540, 568, 540, 580, 540, 576, 544, 576,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 1656, 576};
unsigned int TIMER_OFF[] = {9096, 4504, 576, 540, 580, 536, 576, 544, 576, 544, 576, 536, 572,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 1648, 580};
unsigned int NUM_1[] = {9092, 4504, 576, 540, 580, 532, 576, 536, 576, 544, 576, 544, 572,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 1652, 568};
unsigned int NUM_2[] = {9096, 4504, 580, 540, 576, 540, 572, 544, 576, 540, 576, 532, 588,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 1648, 580};
unsigned int NUM_3[] = {9088, 4504, 580, 540, 572, 540, 576, 544, 576, 532, 584, 532, 576,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 1652, 580};
unsigned int NUM_4[] = {9088, 4516, 576, 544, 576, 532, 576, 540, 576, 540, 580, 536, 580,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 2232, 576};
unsigned int NUM_5[] = {9088, 4516, 576, 544, 568, 540, 576, 540, 576, 540, 580, 540, 580,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 1656, 576};
unsigned int NUM_6[] = {9088, 4516, 596, 520, 576, 540, 576, 544, 576, 544, 568, 544, 600,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 2232, 576};
unsigned int NUM_7[] = {9108, 4508, 576, 544, 604, 512, 576, 544, 572, 540, 604, 520, 576,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 1652, 600};
unsigned int NUM_8[] = {9116, 4468, 576, 540, 588, 536, 580, 540, 576, 540, 580, 536, 580,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 1656, 576};
unsigned int HOUR_2[] = {9076, 4508, 584, 532, 572, 536, 580, 540, 576, 540, 568, 536, 576,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 1644, 576};
unsigned int HOUR_4[] = {9096, 4504, 580, 536, 572, 548, 568, 540, 580, 536, 576, 544, 576,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 1656, 576};
unsigned int HOUR_6[] = {9080, 4516, 568, 540, 576, 540, 576, 544, 576, 532, 576, 544, 576,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 1652, 568};
unsigned int HOUR_8[] = {9084, 4500, 580, 540, 576, 540, 568, 536, 580, 540, 576, 540, 568,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 2236, 576};
unsigned int MODE_SW_LEFT[] = {9100, 4504, 580, 540, 576, 540, 576, 532, 576, 544, 576, 540, 576,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 1648, 580};
unsigned int MODE_SW_RIGHT[] = {9096, 4508, 576, 544, 576, 532, 576, 540, 576, 544, 576, 540, 568,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 1652, 576};
unsigned int BRIGHTNESS_UP[] = {9100, 4504, 580, 536, 576, 544, 576, 544, 576, 536, 576, 544, 576,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 1640, 580};
unsigned int BRIGHTNESS_DOWN[] = {9088, 4504, 580, 540, 572, 540, 572, 540, 576, 544, 572, 532, 576,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 1648, 572};

int getDistance(long time)
{
    // Calculates the Distance in mm
    // ((time)*(Speed of sound))/ toward and backward of object) * 10

    int DistanceCalc;                  // Calculation variable
    DistanceCalc = ((time / 2.9) / 2); // Actual calculation in mm
    //DistanceCalc = time / 74 / 2; // Actual calculation in inches

    return DistanceCalc; // return calculated value
}

int LightSensor()
{
    return (int)analogRead(LIGHT_PIN);
}

int DistanceSensor()
{
    long Duration = 0;
    digitalWrite(DISTANCE_TRIGGER_PIN, LOW);
    delayMicroseconds(2);
    digitalWrite(DISTANCE_TRIGGER_PIN, HIGH); // Trigger pin to HIGH
    delayMicroseconds(10);                    // 10us high
    digitalWrite(DISTANCE_TRIGGER_PIN, LOW);  // Trigger pin to HIGH

    Duration = pulseIn(DISTANCE_RECEIVE_PIN, HIGH); // Waits for the echo pin to get high
                                                    // returns the Duration in microseconds

    int Distance_mm = getDistance(Duration); // Use function to calculate the distance
    return Distance_mm;
}

void testRaw(unsigned int *rawbuf, int rawlen)
{
    //irsend.sendRaw(rawbuf, rawlen, 38 /* kHz */);
    delay(100);
}

//CLIENT_NAME format : Arduino_BOARDNAME_NUMBER,
//if board name have space, replace it to '_'(under bar)
#define CLIENT_NAME "Arduino_MKR_Zero_1"
#define LIGHT_VALUE "light"
#define DISTANCE_VALUE "distance"
#define IR_RELAY_FUNCTION "ir_relay"
#define ARG_LIGHT_RELAY_SWITCH "light_relay_power"

void turn_on_relay_ir(void *pData)
{
    int power = 1, res;
    res = GetIntArgumentByName(pData, ARG_LIGHT_RELAY_SWITCH, &power);
    if (res == -1)
    {
        return;
    }

    if (power == 1)
        digitalWrite(RELAY_PIN, HIGH);
    else if (power == 0)
        digitalWrite(RELAY_PIN, LOW);
    else if (power == 3)
        testRaw(ON, sizeof(ON) / sizeof(int));
    else if (power == 2)
        testRaw(OFF, sizeof(OFF) / sizeof(int));
}

ThingClient client_A3(CLIENT_NAME, 60, Serial1);

Value lightValue(LIGHT_VALUE, LightSensor, 0, 2000, 5000);
Value distanceValue(DISTANCE_VALUE, DistanceSensor, 0, 30000, 5000);
Function IR_Relay_Fucntion(IR_RELAY_FUNCTION, turn_on_relay_ir, 1, 1);
Argument argLightRelaySwitch(ARG_LIGHT_RELAY_SWITCH, 0, 4, INTEGER);
Attribute Ir_Relay_Function_EnergyAttribute("light_Energy[J]", 50, DOUBLE);

String client_name(CLIENT_NAME);

void setup()
{
    Serial1.begin(9600);

    delay(1000);

    IR_Relay_Fucntion.Add_argument(argLightRelaySwitch);
    IR_Relay_Fucntion.Add_functionattribute(Ir_Relay_Function_EnergyAttribute);
    client_A3.Add(lightValue);
    client_A3.Add(distanceValue);
    client_A3.Add(IR_Relay_Fucntion);
    client_A3.Setting();
}

void loop()
{
    client_A3.DoLoop();
}
